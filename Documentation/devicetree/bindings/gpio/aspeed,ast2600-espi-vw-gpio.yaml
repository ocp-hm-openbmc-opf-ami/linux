## Documentation/devicetree/bindings/gpio/aspeed,ast2600-espi-vw-gpio.yaml
```yaml
# SPDX-License-Identifier: (GPL-2.0-only OR BSD-2-Clause)
%YAML 1.2
---
$id: http://devicetree.org/schemas/gpio/aspeed,ast2600-espi-vw-gpio.yaml#
$schema: http://devicetree.org/meta-schemas/core.yaml#

title: Aspeed ESPI VW GPIO controller

maintainers:
  - Nidhin M S <nidhin.ms@intel.com>

description:
  The ASPEED eSPI Slave Interface shall support the eSPI Virtual Wire
  channel and implement support for the General Purpose I/O Expander
  Virtual Wire group (Index 128..255) which allows the master to
  control GPIOs on the slave. The aim of this driver is to
  expose virtual wire gpios to be used as regular gpios using libgpiod.
  This module will work as a child of espi.

properties:
  compatible:
    const: aspeed,ast2600-espi-vw-gpio
  gpio-count:
    description: Number of VW GPIO lines. This include unnamed GPIO lines also.
    $ref: /schemas/types.yaml#/definitions/uint32
    minimum: 1
    maximum: 32
  gpio-names:
    description:
      Array of human readable names to be used for each GPIO. Length can be less
      than or equal to gpio-count property. Refer gpio-names-mask for usage.
    $ref: /schemas/types.yaml#/definitions/string-array
    minItems: 1
    maxItems: 32
  gpio-names-mask:
    description:
      Used to identify which gpio name maps to which index. For example if
      we have 32 GPIO lines and gpio-names has only 6 then this mask will be
      used to identify the 6 GPIOs which has names and all other GPIO lines
      will be marked as unused
    $ref: /schemas/types.yaml#/definitions/uint32
    minimum: 0x000000
    maximum: 0xffffff
  gpio-dir-mask:
    description:
      Bitmask used to identify which GPIO is input and which is output.
      1 denotes output and 0 means input GPIO.
    $ref: /schemas/types.yaml#/definitions/uint32
    minimum: 0x000000
    maximum: 0xffffff
  interrupts:
    maxItems: 1

required:
  - compatible
  - gpio-count
  - gpio-names-mask
  - gpio-dir-mask
  - gpio-names
  - interrupts

additionalProperties: false

examples:
  - |
    vwgpio: vwgpio@0 {
      compatible = "aspeed,ast2600-espi-vw-gpio";
      gpio-count = <32>;
      gpio-names-mask = <0x000001F1>;
      gpio-dir-mask = <0x00000FF0>;
      gpio-names = "VW_FM_BIOS_POST_CMPLT_N",
        "VW_FM_DUAL_PARTITION_N", "VW_FM_STANDALONE_MODE_N",
        "VW_FM_4S_8S_N_MODE", "VW_FM_NODE_ID_1", "VW_FM_NODE_ID_0";
      status = "disabled";
    };
```

## Documentation/devicetree/bindings/gpio/intel,gpio.yaml
```yaml
# SPDX-License-Identifier: (GPL-2.0 OR BSD-2-Clause)
%YAML 1.2
---
$id: http://devicetree.org/schemas/gpio/intel,smart.yaml#
$schema: http://devicetree.org/meta-schemas/core.yaml#

title: Intel SmaRT & CLST

maintainers:
  - Agata Wiatrowska <agata.wiatrowska@intel.com>
  - Wojciech Dembinski <wojciech.dembinski@intel.com>

properties:
  compatible:
    enum:
      - intel,smart

  smbalert-gpio:
    maxItems: 1

required:
  - compatible
  - smbalert-gpio

additionalProperties: false

examples:
  - |
    smart {
        compatible = "intel,smart";
        status = "okay";
        smbalert-gpio = <&gpio0 ASPEED_GPIO(Y, 3) GPIO_ACTIVE_HIGH>;
    };

...
```

## Documentation/devicetree/bindings/hwmon/aspeed,ast2600-chassis.yaml
```yaml
# SPDX-License-Identifier: (GPL-2.0-or-later OR BSD-2-Clause)
%YAML 1.2
---
$id: "http://devicetree.org/schemas/hwmon/aspeed,ast2600-chassis.yaml#"
$schema: "http://devicetree.org/meta-schemas/core.yaml#"

title: ASPEED ast2600 chassis intrusion hwmon driver

maintainers:
  - Matthew Simmering <matthew.simmering@intel.com>

description: |
  This module monitors the CHAI10 register on ASPEED ast2600 boards
  in order to detect chassis intrusion.

properties:
  compatible:
    items:
      - const: aspeed,ast2600-chassis

  reg:
    maxItems: 1

  interrupts:
    maxItems: 1

required:
  - compatible
  - reg

additionalProperties: false

examples:
  - |
    chassis: chassis@10 {
      compatible = "aspeed,ast2600-chassis";
      reg = <0x10 0x4>;
      status = "disabled";
    };
```

## Documentation/devicetree/bindings/i3c/snps,dw-i3c-master.yaml
```yaml
# SPDX-License-Identifier: GPL-2.0
%YAML 1.2
---
$id: http://devicetree.org/schemas/i3c/snps,dw-i3c-master.yaml#
$schema: http://devicetree.org/meta-schemas/core.yaml#

title: Synopsys DesignWare I3C master block

maintainers:
  - Alexandre Belloni <alexandre.belloni@bootlin.com>

allOf:
  - $ref: i3c.yaml#

properties:
  compatible:
    const: snps,dw-i3c-master-1.00a

  reg:
    maxItems: 1

  clocks:
    maxItems: 1

  interrupts:
    maxItems: 1

  i3c-od-scl-low-ns:
    description:
      SCL low period for Open-Drain phase. Expressed in nanoseconds.
    minimum: 200

  i3c-od-scl-high-ns:
    description:
      SCL high period for Open-Drain phase. Expressed in nanoseconds.
    minimum: 25

  i3c-pp-scl-low-ns:
    description:
      SCL low period for Push-Pull phase. Expressed in nanoseconds.
    minimum: 25

  i3c-pp-scl-high-ns:
    description:
      SCL high period for Push-Pull phase. Expressed in nanoseconds.
    minimum: 25

  sda-tx-hold-ns:
    description:
      SDA Hold Time (Thd_dat). Expressed in nanoseconds. Not validated by
      driver. Out-of-range values will be trimmed to the range.
      This parameter is not supported by old IP versions.
    minimum: 5
    maximum: 35

required:
  - compatible
  - reg
  - clocks
  - interrupts

unevaluatedProperties: false

examples:
  - |
    i3c-master@2000 {
        compatible = "snps,dw-i3c-master-1.00a";
        #address-cells = <3>;
        #size-cells = <0>;
        reg = <0x02000 0x1000>;
        interrupts = <0>;
        clocks = <&i3cclk>;

        eeprom@57{
            compatible = "atmel,24c01";
            reg = <0x57 0x0 0x10>;
            pagesize = <0x8>;
        };
    };
...
```

## Documentation/devicetree/bindings/rtc/nxp,pcf85053.yaml
```yaml
# SPDX-License-Identifier: (GPL-2.0-only OR BSD-2-Clause)
%YAML 1.2
---
$id: http://devicetree.org/schemas/rtc/nxp,pcf85053.yaml#
$schema: http://devicetree.org/meta-schemas/core.yaml#

title: NXP PCF85053 RTC Bindings

properties:
  compatible:
    enum:
      - nxp,pcf85053
  reg:
    maxItems: 1

required:
  - compatible
  - reg

additionalProperties: false

examples:
  - |
    i2c {
      #address-cells = <1>;
      #size-cells = <0>;
      rtc@0 {
        compatible = "nxp,pcf85053";
        reg = <0x6f>;
      };
    };
```

## Documentation/devicetree/bindings/soc/aspeed/aspeed-espi-mmbi.yaml
```yaml
# SPDX-License-Identifier: (GPL-2.0-only OR BSD-2-Clause)
%YAML 1.2
---
$id: "http://devicetree.org/schemas/soc/aspeed/aspeed-espi-mmbi.yaml#"
$schema: "http://devicetree.org/meta-schemas/core.yaml#"

title: Aspeed AST26xx MMBI Controller

maintainers:
 - Apparao Puli <apparao.puli@intel.com>

description: |
  This binding describes the  MMBI controller in the AST26xx SOCs.
  The MMBI Controller allows the memory mapping over eSPI and thus
  allows efficient memory sharing between Host and BMC.

properties:
  compatible:
    enum:
      - aspeed,ast2600-espi-mmbi

  reg:
    maxItems: 1
    description: contains the MMBI control register and size

  interrupts:
    maxItems: 1

  clocks:
    maxItems: 1
    description: A reference to syscon node describing the clocks

  aspeed,espi:
    description: a reference to the eSPI controller of the Aspeed SOC
    allOf:
      - $ref: /schemas/types.yaml#/definitions/phandle

  aspeed,lpc:
    description: a reference to the LPC controller of the Aspeed SOC
    allOf:
      - $ref: /schemas/types.yaml#/definitions/phandle

  memory-region:
    maxItems: 1
    description:
      contains a phandle to the BMC SOC memory mapping base address
      and its size

  host-map-addr:
    maxItems: 1
    description: contains a base address which is mapped on host side

required:
  - compatible
  - reg
  - interrupts
  - clocks
  - aspeed,espi
  - aspeed,lpc
  - memory-region
  - host-map-addr

additionalProperties: false

examples:
  - |
    #include <dt-bindings/interrupt-controller/arm-gic.h>
    #include <dt-bindings/clock/ast2600-clock.h>
    #include <dt-bindings/interrupt-controller/aspeed-scu-ic.h>

    reserved-memory {
        #address-cells = <1>;
        #size-cells = <1>;
        ranges;

        espi_mmbi_memory: mmbi@9eff0000 {
            reg = <0x9EFF0000 0x10000>;
            no-map;
        };
    };

    mmbi: mmbi@1e6ee800 {
        compatible = "aspeed,ast2600-espi-mmbi";
        reg = <0x1e6ee800 0x50>;
        interrupts = <GIC_SPI 108 IRQ_TYPE_LEVEL_HIGH>;
        clocks = <&syscon ASPEED_CLK_GATE_ESPICLK>;
        aspeed,espi = <&espi>;
        aspeed,lpc = <&lpc>;
        status = "disabled";
        host-map-addr = <0xFE0B0000>;
        memory-region = <&espi_mmbi_memory>;
    };
```

## Documentation/devicetree/bindings/soc/aspeed/aspeed-spilock.yaml
```yaml
# SPDX-License-Identifier: (GPL-2.0-only OR BSD-2-Clause)
%YAML 1.2
---
$id: "http://devicetree.org/schemas/soc/aspeed/aspeed-spilock.yaml#"
$schema: "http://devicetree.org/meta-schemas/core.yaml#"

title: Aspeed AST26xx SPILOCK Controller

maintainers:
 - Meghan Saitwal <meghan.saitwal@intel.com>

description: |
  This binding describes the SPILOCK controller in the AST26xx SOCs.
  The SPILOCK Controller allows the locking or unlocking of specific
  SPI region via Sysfs.

properties:
  compatible:
    enum:
      - aspeed,ast2600-spilock

  reg:
    maxItems: 1
    description: contains the FMC start register and size

required:
  - compatible
  - reg

additionalProperties: false

examples:
  - |
    spilock: spilock@1e620000 {
        compatible = "aspeed,ast2600-spilock";
        reg = <0x1e620000 0x180>;
    };
```

## Documentation/devicetree/bindings/soc/nuvoton/nuvoton,espi-mmbi.yaml
```yaml
# SPDX-License-Identifier: (GPL-2.0-only OR BSD-2-Clause)
%YAML 1.2
---
$id: http://devicetree.org/schemas/soc/nuvoton/nuvoton-espi-mmbi.yaml#
$schema: "http://devicetree.org/meta-schemas/core.yaml#"

title: Nuvoton ESPI MMBI driver

maintainers:
  - Tomer Maimon <Tomer.Maimon@nuvoton.com>
  - Ban Feng <kcfeng0@nuvoton.com>
  - Stanley Chu <yschu@nuvoton.com>

description: |
  This binding describes the  MMBI controller in the BMC SOCs.
  The MMBI Controller allows the memory mapping over eSPI and thus
  allows efficient memory sharing between Host and BMC.

properties:
  compatible:
    enum:
      - nuvoton,npcm845-espi-mmbi

  reg:
    maxItems: 1
    description: contains the MMBI control register and size

  interrupts:
    maxItems: 1

  nuvoton,espi:
    description: a reference to the eSPI controller of the BMC SOC
    allOf:
      - $ref: /schemas/types.yaml#/definitions/phandle

  memory-region:
    maxItems: 1
    description: |
      contains a phandle to the BMC SOC memory mapping base address
      and its size

  use-interrupt:
    type: boolean
    description: |
      if defined, BMC will get an interrupt when host update the offset
      address in the share memory.

  poll-interval-ms:
    maxItems: 1
    minimum: 1
    maximum: 1000
    default: 50
    description: |
      if use-interrupt is not defined, this is the polling interval that
      define how often BMC will check the h2b buffer status periodically.

required:
  - compatible
  - reg
  - interrupts
  - nuvoton,espi
  - memory-region

additionalProperties: false

examples:
  - |
    #include <dt-bindings/mmbi/protocols.h>

    reserved-memory {
        #address-cells = <2>;
        #size-cells = <2>;
        ranges;

        espi_mmbi_memory: mmbi@0xc0008000 {
            reg = <0x0 0xc0008000 0x0 0x1000>;
            no-map;
        };
    };

    mmbi: mmbi@c0001000 {
        compatible = "nuvoton,npcm845-espi-mmbi";
        reg = <0x0 0xc0001000 0x0 0x800>;
        interrupts = <GIC_SPI 11 IRQ_TYPE_LEVEL_HIGH>;
        memory-region = <&espi_mmbi_memory>;
        nuvoton,espi = <&espi>;
        status = "okay";
        instance@0 {
            protocols = /bits/ 8 <MMBI_PROTOCOL_RAS_OFFLOAD>;
        };
    };
```

## Documentation/devicetree/bindings/soc/nuvoton/nuvoton,npcm-fiu-tip.yaml
```yaml
# SPDX-License-Identifier: (GPL-2.0-only OR BSD-2-Clause)
%YAML 1.2
---
$id: http://devicetree.org/schemas/soc/nuvoton/nuvoton,npcm-fiu-tip.yaml#
$schema: http://devicetree.org/meta-schemas/core.yaml#

title: Nuvoton BMC NPCM FIU TIP

maintainers:
  - Tomer Maimon <tmaimon77@gmail.com>

description:
  Nuvoton BMC NPCM FIU TIP driver manages the FIU devices through the TIP.

  The Nuvoton BMC NPCM FIU TIP shouldn't mange the same flash in parallel with
  NPCM FIU driver, please see Documentation\devicetree\bindings\spi\nuvoton,npcm-fiu.txt

properties:
  compatible:
    items:
      - enum:
          - nuvoton,npcm845-fiu-tip
  reg:
    maxItems: 1

  mboxes:
    description:
      Using mailbox to communicate with TIP, it should have this
      property and list of phandle, mailbox specifiers. See

      - items:
          - description: TIP mailbox channel 1

  mbox-names:
      - items:
          - const: fiu_tip

  memory-region:
    maxItems: 1
    description:
      Contains the TIP FIU reserved memory. the minimum TIP FIU
      reserved memory size is two pages size (2Kb)

patternProperties:
  '^spi-nor@':
    type: object

    properties:
      nuvoton,npcm-fiu-tip-num:
        $ref: /schemas/types.yaml#/definitions/uint32
        description:
          Contain FIU ID number, the FIU ID are as follow:
	  FIU0 - 0
	  FIU1 - 1
	  FIU3 - 2
	  FIUX - 3
     
      nuvoton,npcm-fiu-tip-cs:
        $ref: /schemas/types.yaml#/definitions/uint32
        description:
          Contain the FIU ID chip select.

    required:
      - nuvoton,npcm-fiu-tip-num
      - nuvoton,npcm-fiu-tip-cs

    additionalProperties: false

required:
  - compatible
  - reg
  - mboxes
  - mbox-names

additionalProperties: false

examples:
  - |
    reserved-memory {
        #address-cells = <2>;
        #size-cells = <2>;
        ranges;
        
        tip_mbox_memory: tip_mbox_memory@0x0 {
            reg = <0x0 0x10000000 0x0 0x8000>;
            no-map;
        };
    };

    fiu_tip: fiu_tip@f0800E28 {
        compatible = "nuvoton,npcm845-fiu-tip";
        reg = <0x0 0xf0800E28 0x0 0x20>;
        memory-region = <&tip_mbox_memory>;
        mboxes = <&tip_mbox 0 1>;
        mbox-names = "fiu_tip";
        #address-cells = <1>;
        #size-cells = <1>;
        spi-nor@0 {
            label = "fiu0_tip_cs0";
            nuvoton,npcm-fiu-tip-num = <0>;
            nuvoton,npcm-fiu-tip-cs = <0>;
            partitions@80000000 {
                compatible = "fixed-partitions";
                #address-cells = <1>;
                #size-cells = <1>;
                flash@0 {
            	   label = "Flash0_cs0";
            	   reg = <0x0 0x0>;
            	};
            };
	};
    };
```
