## drivers/jtag/Kconfig
```kconfig
menuconfig JTAG
	tristate "JTAG support"
	help
	  This provides basic core functionality support for JTAG class devices.
	  Hardware that is equipped with a JTAG microcontroller can be
	  supported by using this driver's interfaces.
	  This driver exposes a set of IOCTLs to the user space for
	  the following commands:
	    SDR: Performs an IEEE 1149.1 Data Register scan
	    SIR: Performs an IEEE 1149.1 Instruction Register scan.
	    RUNTEST: Forces the IEEE 1149.1 bus to a run state for a specified
	    number of clocks or a specified time period.

	  If you want this support, you should say Y here.

	  To compile this driver as a module, choose M here: the module will
	  be called jtag.

menuconfig JTAG_ASPEED
	tristate "Aspeed SoC JTAG controller support"
	depends on JTAG && HAS_IOMEM
	depends on ARCH_ASPEED || COMPILE_TEST
	help
	  This provides support for Aspeed JTAG devices equipped on Aspeed
	  SoC 24xx, 25xx and 26xx families. Driver allows programming of
	  hardware devices, connected to SoC through the JTAG interface.

	  If you want this support, you should say Y here.

	  To compile this driver as a module, choose M here: the module will
	  be called jtag-aspeed.

config USE_INTERRUPTS
	bool "Use interrupts as event wait mechanism"
	depends on JTAG_ASPEED
	default n
	help
	  Aspeed SoC 24xx, 25xx and 26xx driver monitors the JTAG shift
	  operation completion by either polling or waiting for an interrupt.

	  This flag is used by Aspeed driver to select from either interrupt or
	  polling as wait mechanism for JTAG controller completion events.

	  If you want interrupt support, you should say Y here.

	  If you want polling support, you should say N here.
```

## drivers/peci-legacy/Kconfig
```kconfig
#
# Platform Environment Control Interface (PECI) subsystem configuration
#

choice
	prompt "PECI supported subsystem"
	default WANT_PECI_LEGACY
	help
	  Temporarily, to make the transition to upstream PECI easier, two
	  mutually exclusive PECI subsystems (legacy and upstream) are supported.
	  This option enforces selecting only one PECI subsystem at the same time.
	  Note that once the transition is completed, the legacy PECI support will be removed.

config WANT_PECI_LEGACY
	bool "Use legacy PECI"
	help
	  Select non-upstream PECI subsystem.
	  This will be removed once upstream PECI transition is completed.

config WANT_PECI
	bool "Use upstream PECI"
	help
	  Select PECI subsystem available in the mainline kernel.

endchoice

menuconfig PECI_LEGACY
	tristate "PECI legacy support"
	select CRC8
	depends on WANT_PECI_LEGACY

	help
	  The Platform Environment Control Interface (PECI) is a one-wire bus
	  interface that provides a communication channel from Intel processors
	  and chipset components to external monitoring or control devices.

	  If you want PECI support, you should say Y here and also to the
	  specific driver for your bus adapter(s) below.

	  This support is also available as a module. If so, the module
	  will be called peci-core.

if PECI_LEGACY

config PECI_CHARDEV_LEGACY
	tristate "PECI device interface"
	help
	  Say Y here to use peci-* device files, usually found in the /dev
	  directory on your system. They make it possible to have user-space
	  programs use the PECI bus.

	  This support is also available as a module. If so, the module
	  will be called peci-dev.

source "drivers/peci-legacy/busses/Kconfig"

endif # PECI_LEGACY
```
