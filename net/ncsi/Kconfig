## net/ncsi/Kconfig
```kconfig
# SPDX-License-Identifier: GPL-2.0-only
#
# Configuration for NCSI support
#

config NET_NCSI
	bool "NCSI interface support"
	depends on INET
	help
	  This module provides NCSI (Network Controller Sideband Interface)
	  support. Enable this only if your system connects to a network
	  device via NCSI and the ethernet driver you're using supports
	  the protocol explicitly.
config NCSI_OEM_CMD_GET_MAC
	bool "Get NCSI OEM MAC Address"
	depends on NET_NCSI
	help
	  This allows to get MAC address from NCSI firmware and set them back to
		controller.
config NCSI_OEM_CMD_KEEP_PHY
	bool "Keep PHY Link up"
	depends on NET_NCSI
	help
	  This allows to keep PHY link up and prevents any channel resets during
	  the host load.
config NCSI_AMI_NON_AEN_SUPPORT
	bool "Non-AEN Support"
	default n
	depends on NET_NCSI
	help
		If the Network Controller does not support AEN, a Kernel Timer will be invoked

config NCSI_AMI_TIMER_INTERVAL_FOR_GET_LINK_STATUS
	int "NCSI Timer Delay for Get Link Status"
	default 5
	depends on NET_NCSI
	help
		Periodic time interval(in seconds) for issuing the Get Link Status command to the network controller.
config NCSI_AMI_MANUAL_DETECT
	bool "NCSI Manual Detect"
	depends on NET_NCSI
	help
	  Manual Detect NCSI devices instead of start NCSI devices during boot.
config NCSI_AMI_ASYNC_RESET
	bool "NCSI Async Reset"
	depends on NET_NCSI
	help
	  This feature detects asynchronous reset on the network controller and reconfigures the link, 
	  a Kernel Timer will be invoked to periodically issue Get Link Status command to the Network Controller.
```
