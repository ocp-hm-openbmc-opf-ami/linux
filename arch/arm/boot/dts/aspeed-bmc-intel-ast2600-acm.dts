// SPDX-License-Identifier: GPL-2.0+

#include "aspeed-bmc-intel-ast2600.dts"

&mac3 {
	status = "okay";
	use-ncsi;
	pinctrl-names = "default";
	pinctrl-0 = <&pinctrl_rmii4_default>;
	clocks = <&syscon ASPEED_CLK_GATE_MAC4CLK>,
		 <&syscon ASPEED_CLK_MAC4RCLK>;
	clock-names = "MACCLK", "RCLK";
	phy-mode = "rmii";
	phy-handle = <&ethphy2>;
};

